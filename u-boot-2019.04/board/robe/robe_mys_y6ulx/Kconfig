## u-boot-2019.04/board/robe/robe_mys_y6ulx/Kconfig
```kconfig
if TARGET_ROBE_MYS_Y6ULX

config SYS_BOARD
	default "robe_mys_y6ulx"

config SYS_VENDOR
	default "robe"

config SYS_CONFIG_NAME
	default "robe_mys_y6ulx"

endif
```
